## conf/layer.conf
```bitbake
# We have a conf and classes directory, add to BBPATH
BBPATH .= ":${LAYERDIR}"

# We have recipes-* directories, add to BBFILES
BBFILES += "${LAYERDIR}/recipes-*/*/*.bb \
            ${LAYERDIR}/recipes-*/*/*.bbappend"

BBFILE_COLLECTIONS += "meta-rpi-override-cmdline"
BBFILE_PATTERN_meta-rpi-override-cmdline = "^${LAYERDIR}/"
BBFILE_PRIORITY_meta-rpi-override-cmdline = "6"

LAYERDEPENDS_meta-rpi-override-cmdline = "core"
LAYERSERIES_COMPAT_meta-rpi-override-cmdline = "mickledore"
```
